## boards/vcc-gnd/stm32f103ze_mini/stm32f103ze_mini_defconfig
```kconfig
# Copyright (c) 2024 FindlayFeng
# SPDX-License-Identifier: Apache-2.0

# enable uart driver
CONFIG_SERIAL=y
# enable console
CONFIG_CONSOLE=y
CONFIG_USE_SEGGER_RTT=y
CONFIG_RTT_CONSOLE=y

# enable GPIO
CONFIG_GPIO=y

# enable clocks
CONFIG_CLOCK_CONTROL=y

# enable pin controller
CONFIG_PINCTRL=y
```
